VERSION ""

NS_ :

BS_:

BU_: DBG IO

BO_ 42 IOFloat32: 8 IO
 SG_ Float32Signal : 0|16@1- (1,0) [0|0] "" DBG

SIG_VALTYPE_ 42 Float32Signal: 1;
